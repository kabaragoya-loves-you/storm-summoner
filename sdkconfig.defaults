## sdkconfig.defaults
```kconfig
# Storm Summoner ESP32-P4 Configuration Defaults
# This file contains project-specific menuconfig values.
# When building for the first time, these values will be applied automatically.

#
# Serial flasher config
#
CONFIG_ESPTOOLPY_FLASHMODE_DIO=y
CONFIG_ESPTOOLPY_FLASHFREQ_80M=y
CONFIG_ESPTOOLPY_FLASHSIZE_16MB=y

#
# Partition Table
#
CONFIG_PARTITION_TABLE_CUSTOM=y
CONFIG_PARTITION_TABLE_CUSTOM_FILENAME="partitions.csv"

#
# Compiler options
#
CONFIG_COMPILER_OPTIMIZATION_DEBUG=y

#
# ESP System Settings
#
CONFIG_ESP_DEFAULT_CPU_FREQ_MHZ_360=y
CONFIG_ESP_CONSOLE_USB_SERIAL_JTAG=y

#
# Cache config
#
CONFIG_CACHE_L2_CACHE_128KB=y

#
# ESP PSRAM
#
CONFIG_SPIRAM=y
CONFIG_SPIRAM_SPEED_80M=y
CONFIG_SPIRAM_USE_MALLOC=y
CONFIG_SPIRAM_MALLOC_RESERVE_INTERNAL=32768

#
# Touch Sensor
#
CONFIG_TOUCH_CTRL_FUNC_IN_IRAM=y
CONFIG_TOUCH_ISR_IRAM_SAFE=y

#
# TinyUSB Stack Descriptor configuration
#
CONFIG_TINYUSB_DESC_MANUFACTURER_STRING="Kabaragoya"
CONFIG_TINYUSB_DESC_PRODUCT_STRING="Storm Summoner"
CONFIG_TINYUSB_DESC_SERIAL_STRING="STORM001"
CONFIG_TINYUSB_MIDI_COUNT=0
CONFIG_TINYUSB_CDC_ENABLED=n
CONFIG_TINYUSB_CDC_COUNT=0
CONFIG_TINYUSB_MSC_ENABLED=n

#
# FreeRTOS
#
CONFIG_FREERTOS_USE_TRACE_FACILITY=n
CONFIG_FREERTOS_GENERATE_RUN_TIME_STATS=n
CONFIG_FREERTOS_RUN_TIME_STATS_USING_ESP_TIMER=n
CONFIG_FREERTOS_TIMER_TASK_STACK_DEPTH=4096

#
# LittleFS
#
CONFIG_LITTLEFS_MAX_PARTITIONS=1
CONFIG_LITTLEFS_MALLOC_STRATEGY_SPIRAM=y
```
